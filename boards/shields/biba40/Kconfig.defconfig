## boards/shields/biba40/Kconfig.defconfig
```kconfig
if SHIELD_BIBA40_LEFT

# Name must be less than 16 characters long!
config ZMK_KEYBOARD_NAME
    default "Biba40"

config ZMK_SPLIT_ROLE_CENTRAL
    default y

endif

if SHIELD_BIBA40_LEFT || SHIELD_BIBA40_RIGHT

config ZMK_SPLIT
    default y

endif
```

## boards/shields/biba40/Kconfig.shield
```kconfig
# No whitespace after the comma or in your part name!
config SHIELD_BIBA40_LEFT
    def_bool $(shields_list_contains,biba40_left)

# No whitespace after the comma or in your part name!
config SHIELD_BIBA40_RIGHT
    def_bool $(shields_list_contains,biba40_right)

CONFIG_ZMK_SOFT_OFF=y
```
